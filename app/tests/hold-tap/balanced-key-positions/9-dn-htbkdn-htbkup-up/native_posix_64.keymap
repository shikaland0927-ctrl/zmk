#include <dt-bindings/zmk/keys.h>
#include <behaviors.dtsi>
#include <dt-bindings/zmk/kscan_mock.h>
#include "../behavior_keymap.dtsi"

&kscan {
    events = <
        ZMK_MOCK_PRESS(0,0,10)
        ZMK_MOCK_PRESS(0,2,10)   // balanced key bound to another hold-tap
        ZMK_MOCK_RELEASE(0,2,10)
        ZMK_MOCK_RELEASE(0,0,10)
    >;
};
